
/* DO NOT EDIT!  This is an autogenerated file.  See tools/layoutrom.py. */
OUTPUT_FORMAT("elf32-i386")
OUTPUT_ARCH("i386")
SECTIONS
{

        data16_start = 0x5800 ;
        .data16 data16_start : {
*(.data16.src/misc.c.132)
*(.data16.src/misc.c.142)
*(.data16.src/misc.c.148)
*(.data16.src/misc.c.166)
*(.data16.export.src/pmm.c.375)
*(.data16.src/floppy.c.28)
*(.data16.src/floppy.c.70)
*(.data16.src/mouse.c.113)
*(.data16.src/kbd.c.280)
*(.data16.export.src/pnpbios.c.31)
*(.data16.export.src/pirtable.c.21)
*(.data16.export.src/pcibios.c.222)
*(.data16.src/usb-hid.c.112)
*(.data16.src/usb-hid.c.96)
*(.data16.src/block.c.15)
*(.data16.src/cdrom.c.109)
*(.data16.src/stacks.c.127)
*(.data16.src/misc.c.14)
*(.data16.src/smp.c.35)
*(.data16.src/smp.c.36)
*(.data16.src/vgahooks.c.16)
*(.data16.src/misc.c.18)
*(.data16.src/misc.c.139)
*(.data16.src/system.c.294)
*(.data16.src/system.c.295)
*(.data16.src/stacks.c.128)
*(.data16.src/pirtable.c.12)
*(.data16.src/clock.c.60)
*(.data16.src/smp.c.20)
*(.data16.src/smp.c.21)
*(.data16.src/usb-hid.c.13)
code16_rodata = . ;
*(.rodata.str1.1)
*(.rodata.__func__.2092)
*(.rodata.__func__.2037)
*(.rodata.__func__.2025)
*(.rodata.__func__.20205)
*(.rodata.__func__.20137)
*(.rodata.__func__.42510)
*(.rodata.__func__.42613)
*(.rodata.__func__.42492)
*(.rodata.__func__.64064)
*(.rodata.__func__.63839)
*(.rodata.__func__.69725)
*(.rodata.__func__.80340)
*(.rodata.__func__.82485)

        }

        text16_start = 0x85d6 ;
        .text16 text16_start : {
*(.text.handle_11)
*(.text.handle_02)
*(.text.handle_75)
*(.text.pmm_free_data.4745)
*(.text.pmm_free.1834)
*(.text.floppy_cmd.17157)
*(.text.check_recal_drive.17439)
*(.text.process_floppy_op.1223)
*(.text.handle_0e)
*(.text.udelay.1730)
*(.text.process_mouse.1709)
*(.text.pci_next.19998)
*(.text.handle_14)
*(.text.handle_17)
*(.text.rtc_updating.34605)
*(.text.handle_70)
*(.text.handle_1ab1.1754)
*(.text.handle_hwpic1)
*(.text.usb_poll_intr.60867)
*(.text.handle_1553.1752)
*(.text.basic_access.80083)
*(.text.extended_access.80147)
*(.text.disk_1300.80266)
*(.text.disk_1310.80585)
*(.text.handle_76)
*(.text.putuint.9742.clone.1)
*(.text.bvprintf.9806.clone.0)
*(.text.pmm_malloc.1832)
*(.text.handle_pmm)
*(.text.dump_regs.10019)
*(.text.__process_key.27270)
*(.text.process_key.1705)
*(.text.prockeys.72633)
*(.text.handle_key.72733)
*(.text.handle_08)
*(.text.await_not_bsy.20152)
*(.text.ata_pio_transfer.20669)
*(.text.send_cmd.20413)
*(.text.ata_readwrite.21200)
*(.text.process_ata_misc_op.20381)
*(.text.i8042_wait_write.42503)
*(.text.i8042_command.23898)
*(.text.ps2_sendbyte.42650)
*(.text.handle_16)
*(.text.handle_74)
*(.text.handle_09)
*(.text.handle_resume)
*(.text.handle_pnp)
*(.text.wait_td.64059)
*(.text.uhci_send_bulk.60595)
*(.text.ehci_wait_td.69720)
*(.text.ehci_send_bulk.60691)
*(.text.usb_send_bulk.60856)
*(.text.process_op.1208)
*(.text.__send_disk_op.14761)
*(.text.cdemu_read.39086)
*(.text.disk_1305.80338)
*(.text.disk_13.82387)
*(.text.handle_legacy_disk.82458)
*(.text.handle_40)
*(.text.asm.transition16)
*(.text.asm.__call16)
*(.text.asm.__call16_from32)
*(.text.asm.irq_trampoline_0x10)
*(.text.asm.irq_trampoline_0x13)
*(.text.asm.entry_pmm)
*(.text.asm.entry_pnp_real)
*(.text.asm.apm16protected_entry)
*(.text.asm.apm32protected_entry)
*(.text.asm.export.post32)
*(.text.asm.irqentryarg)
*(.text.asm.entry_13)
*(.text.asm.entry_70)
*(.text.asm.entry_19)
*(.text.asm.entry_18)
. = ( 0xe05b - text16_start ) ;
*(.fixedaddr.0xe05b)
*(.text.ps2_command.42672)
*(.text.asm.entry_75)
. = ( 0xe2c3 - text16_start ) ;
*(.fixedaddr.0xe2c3)
*(.text.ps2_recvbyte.42608)
*(.text.panic.1646)
*(.text.asm.irq_trampoline_0x18)
. = ( 0xe3fe - text16_start ) ;
*(.fixedaddr.0xe3fe)
. = ( 0xe401 - text16_start ) ;
*(.fixedaddr.0xe401)
*(.text.handle_1a)
*(.text.asm.entry_74)
. = ( 0xe6f2 - text16_start ) ;
*(.fixedaddr.0xe6f2)
. = ( 0xe6f5 - text16_start ) ;
*(.fixedaddr.0xe6f5)
*(.text.handle_05)
. = ( 0xe729 - text16_start ) ;
*(.fixedaddr.0xe729)
. = ( 0xe739 - text16_start ) ;
*(.fixedaddr.0xe739)
*(.text.dequeue_key.26840)
. = ( 0xe82e - text16_start ) ;
*(.fixedaddr.0xe82e)
*(.text.floppy_pio.17134)
*(.text.asm.entry_76)
*(.text.asm.irq_trampoline_0x16)
. = ( 0xe987 - text16_start ) ;
*(.fixedaddr.0xe987)
*(.text.handle_15c2.1703)
*(.text.asm.irqentry)
. = ( 0xec59 - text16_start ) ;
*(.fixedaddr.0xec59)
*(.text.cdb_read.20128)
*(.text.asm.irq_trampoline_0x15)
. = ( 0xef57 - text16_start ) ;
*(.fixedaddr.0xef57)
*(.text.asm.entry_post)
*(.text.handle_hwpic2)
. = ( 0xefc7 - text16_start ) ;
*(.fixedaddr.0xefc7)
. = ( 0xefd2 - text16_start ) ;
*(.fixedaddr.0xefd2)
*(.text.lba2chs.17521)
*(.text.__dprintf.1654)
. = ( 0xf045 - text16_start ) ;
*(.fixedaddr.0xf045)
*(.text.asm.export.bios32_entry)
. = ( 0xf065 - text16_start ) ;
*(.fixedaddr.0xf065)
*(.text.asm.src/smp.c.66)
. = ( 0xf0a4 - text16_start ) ;
*(.fixedaddr.0xf0a4)
*(.text.handle_15)
*(.text.disk_1346.80820)
. = ( 0xf841 - text16_start ) ;
*(.fixedaddr.0xf841)
*(.text.handle_apm16)
. = ( 0xf84d - text16_start ) ;
*(.fixedaddr.0xf84d)
*(.text.asm.src/util.c.66)
. = ( 0xf859 - text16_start ) ;
*(.fixedaddr.0xf859)
*(.text.handle_13)
*(.text.handle_12)
. = ( 0xfa6e - text16_start ) ;
*(.fixedaddr.0xfa6e)
. = ( 0xfe6e - text16_start ) ;
*(.fixedaddr.0xfe6e)
*(.text.asm.pcibios32_entry)
. = ( 0xfea5 - text16_start ) ;
*(.fixedaddr.0xfea5)
*(.text.asm.transition32)
. = ( 0xfef3 - text16_start ) ;
*(.fixedaddr.0xfef3)
. = ( 0xff00 - text16_start ) ;
*(.fixedaddr.0xff00)
*(.text.asm.entry_hwpic2)
*(.text.asm.irq_trampoline_0x19)
*(.text.handle_10)
. = ( 0xff53 - text16_start ) ;
*(.fixedaddr.0xff53)
. = ( 0xff54 - text16_start ) ;
*(.fixedaddr.0xff54)
*(.text.ndelay_await_not_bsy.20173)
*(.text.asm.entry_hwpic1)
. = ( 0xfff0 - text16_start ) ;
*(.fixedaddr.0xfff0)
. = ( 0xfff5 - text16_start ) ;
*(.fixedaddr.0xfff5)
. = ( 0xfffe - text16_start ) ;
*(.fixedaddr.0xfffe)
. = ( 0xffff - text16_start ) ;
*(.fixedaddr.0xffff)

                text16_end = ABSOLUTE(.) ;
        }

        /* Discard regular data sections to force a link error if
         * 16bit code attempts to access data not marked with VAR16
         */
        /DISCARD/ : { *(.text*) *(.rodata*) *(.data*) *(.bss*) *(COMMON) }

}
