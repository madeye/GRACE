
/* DO NOT EDIT!  This is an autogenerated file.  See tools/layoutrom.py. */
OUTPUT_FORMAT("elf32-i386")
OUTPUT_ARCH("i386")
SECTIONS
{

        code32seg_start = 0x5248 ;
        .text32seg code32seg_start : {
                freespace_end = . ;
*(.text.pci_next.5312)
*(.text.handle_pcibios32)
*(.text.handle_apm32)
code32seg_rodata = . ;
*(.rodata.str1.1)

                code32seg_end = ABSOLUTE(.) ;
        }
        /DISCARD/ : { *(.text*) *(.rodata*) *(.data*) *(.bss*) *(COMMON) }

}
